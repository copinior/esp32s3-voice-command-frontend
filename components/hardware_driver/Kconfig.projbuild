## components/hardware_driver/Kconfig.projbuild
```kconfig
menu "Audio Media HAL"

config ESP_CUSTOM_BOARD
    bool "Custom ESP32-S3 Audio Board"
    depends on IDF_TARGET_ESP32S3
    default y
    help
        Enable customn ESP32-S3 audio board support.    
endmenu
```

## main/Kconfig.projbuild
```kconfig
menu "Application Settings"

config APP_ESPNOW_DEFAULT_DEST_MAC
    string "Default ESP-NOW destination MAC"
    default "FF:FF:FF:FF:FF:FF"
    help
        Default destination MAC used when the ESP32 frontend forwards
        recognized commands over ESP-NOW. Replace this with the MAC address
        of your ESP8266 bridge or target peer before deployment.

endmenu
```

## sdkconfig.defaults
```kconfig
# Version-controlled default configuration for the public ESP32-S3 project.
CONFIG_IDF_TARGET="esp32s3"
CONFIG_ESPTOOLPY_FLASHMODE_QIO=y
CONFIG_ESPTOOLPY_FLASHSIZE_16MB=y
CONFIG_PARTITION_TABLE_CUSTOM=y
CONFIG_PARTITION_TABLE_CUSTOM_FILENAME="partitions.csv"
CONFIG_PARTITION_TABLE_FILENAME="partitions.csv"
CONFIG_PARTITION_TABLE_OFFSET=0x8000
CONFIG_SR_VADN_VADNET1_MEDIUM=y
CONFIG_SR_WN_WN9_HIESP=y
CONFIG_SR_MN_CN_MULTINET7_QUANT=y
CONFIG_SPIRAM=y
CONFIG_SPIRAM_MODE_OCT=y
CONFIG_SPIRAM_SPEED_80M=y
CONFIG_ESP_DEFAULT_CPU_FREQ_MHZ_240=y
CONFIG_ESP32S3_INSTRUCTION_CACHE_32KB=y
CONFIG_ESP32S3_DATA_CACHE_64KB=y
CONFIG_ESP32S3_DATA_CACHE_LINE_64B=y

CONFIG_CN_SPEECH_COMMAND_ID0="da kai che deng"
CONFIG_CN_SPEECH_COMMAND_ID1="guan bi che deng"
CONFIG_CN_SPEECH_COMMAND_ID2="jia su"
CONFIG_CN_SPEECH_COMMAND_ID3="jian su"
CONFIG_CN_SPEECH_COMMAND_ID4="sha che"
CONFIG_CN_SPEECH_COMMAND_ID5="ting che"
CONFIG_CN_SPEECH_COMMAND_ID6="zuo zhuan"
CONFIG_CN_SPEECH_COMMAND_ID7="you zhuan"
CONFIG_CN_SPEECH_COMMAND_ID8="zuo diao tou"
CONFIG_CN_SPEECH_COMMAND_ID9="you diao tou"
CONFIG_CN_SPEECH_COMMAND_ID10="dao che"
CONFIG_CN_SPEECH_COMMAND_ID11="wei zhi mo shi"
CONFIG_CN_SPEECH_COMMAND_ID12="su du mo shi"
CONFIG_CN_SPEECH_COMMAND_ID13="zhuang tai cha xun"
CONFIG_CN_SPEECH_COMMAND_ID14="chong qi xi tong"
CONFIG_CN_SPEECH_COMMAND_ID15="chu shi hua"
CONFIG_APP_ESPNOW_DEFAULT_DEST_MAC="FF:FF:FF:FF:FF:FF"
CONFIG_CN_SPEECH_COMMAND_ID16=""
CONFIG_CN_SPEECH_COMMAND_ID17=""
CONFIG_CN_SPEECH_COMMAND_ID18=""
CONFIG_CN_SPEECH_COMMAND_ID19=""
```
